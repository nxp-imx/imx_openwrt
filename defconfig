## defconfig
```kconfig
CONFIG_TARGET_imx=y
CONFIG_TARGET_imx_cortexa53=y
CONFIG_TARGET_imx_cortexa53_DEVICE_imx8mmini=y
CONFIG_DEVEL=y
CONFIG_KERNEL_GIT_CLONE_URI="https://github.com/nxp-imx/linux-imx.git"
CONFIG_KERNEL_GIT_LOCAL_REPOSITORY=""
CONFIG_KERNEL_GIT_MIRROR_HASH="6624aa88787972004e4c55e0f5820898cd3e325e340bf464d1e93e82b5fe7753"
CONFIG_KERNEL_GIT_REF="lf-6.6.52-2.2.0"
```
