## defconfig
```kconfig
CONFIG_TARGET_imx=y
CONFIG_TARGET_imx_cortexa53=y
CONFIG_TARGET_imx_cortexa53_DEVICE_imx8mmini=y
CONFIG_DEVEL=y
CONFIG_KERNEL_GIT_CLONE_URI="https://github.com/nxp-imx/linux-imx.git"
CONFIG_KERNEL_GIT_LOCAL_REPOSITORY=""
CONFIG_KERNEL_GIT_MIRROR_HASH="e7f80efa922d2dba43a548c4381ee83625f99e903a8c7a9e1205319ae66a2126"
CONFIG_KERNEL_GIT_REF="lf-6.12.49-2.2.0"
```
